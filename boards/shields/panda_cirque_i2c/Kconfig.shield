## boards/shields/panda_cirque_i2c/Kconfig.shield
```kconfig
config SHIELD_PANDA_CIRQUE_I2C
    def_bool $(shields_list_contains,panda_cirque_i2c)

config SHIELD_PANDA_CIRQUE_I2C_PERIPHERAL
    def_bool $(shields_list_contains,panda_cirque_i2c_peripheral)
```

## boards/shields/panda_cirque_receiver/Kconfig.shield
```kconfig
config SHIELD_PANDA_CIRQUE_RECEIVER
    def_bool $(shields_list_contains,panda_cirque_receiver)
```
