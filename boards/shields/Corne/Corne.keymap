/*
 * Copyright (c) 2020 The ZMK Contributors
 *
 * SPDX-License-Identifier: MIT
 */

#include "../../../miryoku/custom_config.h"
#include "../../../miryoku/mapping/42/corne_with_macro.h"
#include "../../../miryoku/miryoku.dtsi"
